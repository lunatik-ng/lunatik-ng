## lib/lunatik/Kconfig
```kconfig
menu "Lunatik Lua engine"

config LUNATIK
	tristate "Enable Lunatik Lua engine"
	default n
	help
	  Enables the Lunatik Lua engine which allows execution of Lua code
	  in the context of the kernel.

config LUNATIK_SYSCALL
	boolean "Provide system call to Lunatik Lua engine"
	default n
	depends on LUNATIK=y
	help
	  For userspace purposes a syscall (#359) is provided.  Signature:
	  sys_lua(char *code, size_t code_len, char *result, size_t result_len).

config DEBUG_LUNATIK
	boolean "Debug Lunatik"
	default n
	depends on LUNATIK
	help
	  Activate DEBUG locally within Lunatik core

source "lib/lunatik/bindings/Kconfig"

endmenu
```

## lib/lunatik/bindings/Kconfig
```kconfig
config LUNATIK_PRINTK
	tristate "Printk bindings for Lua"
	default n
	depends on LUNATIK
	help
	  Provide funtion print(...) to lua code with an interface to printk.

config LUNATIK_INSPECT
	tristate "Inspection functions for Lua"
	default n
	depends on LUNATIK
	help
	  Provide funtions type(o) and gc_count() as simple inspectionfuntions.
	  While type(o) returns the type name of a Lua object as string,
	  gc_count() returns the current amount of memory used by Lua.

config LUNATIK_CRYPTO
	tristate "Crypto library for Lua"
	default n
	depends on LUNATIK
	select LUNATIK_BUFFER
	help
	  The crypto library contains two functions, crypto.sha1 and
	  crypto.random.  crypto.random(x) returns a buffer object of size x
	  filled with random data.  The function is an almost direct mapping to
	  the kernel's get_random_bytes function.

	  crypto.sha1(x) returns a buffer of size 20 bytes (one SHA1 hash) and
	  takes as its parameter x a buffer of data to be hashed.  At the
	  moment, the size of x is limited to PAGE_SZ, which is 4Kb on most x86
	  machines.

config LUNATIK_BUFFER
	tristate "Buffer library for Lua"
	default n
	depends on LUNATIK
	help
	  Calling buffer.new(x) returns a new buffer object of size x.  The
	  buffer object represents a (char *) of length x.  Modifying and
	  reading the buffer follows the familiar table interface:

	  buf = buffer.new(16)
	  buf[1]  = 100
	  buf[16] = 255

	  Buffer objects are used and returned by some of the provided bindings,
	  such as crypto.sha1 and crypto.random.
```
